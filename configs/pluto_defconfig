## configs/pluto_defconfig
```kconfig
BR2_arm=y
BR2_cortex_m4=y
BR2_ARM_INSTRUCTIONS_THUMB=y
BR2_STATIC_LIBS=y
BR2_TOOLCHAIN_BUILDROOT_NEWLIB=y
BR2_GCC_VERSION_4_9_X=y
BR2_TOOLCHAIN_BUILDROOT_CXX=y
BR2_PACKAGE_HOST_GDB=y
BR2_PACKAGE_HOST_GDB_TUI=y
BR2_GDB_VERSION_7_8=y
# BR2_USE_MMU is not set
BR2_PACKAGE_UCLIBCPP=y
BR2_INIT_NONE=y
BR2_ROOTFS_SKELETON_TINY=y
BR2_NUTTX_KERNEL=y
# BR2_PACKAGE_BUSYBOX is not set
BR2_TARGET_ROOTFS_ROMFS=y
# BR2_TARGET_ROOTFS_TAR is not set
BR2_PACKAGE_HOST_GENROMFS=y
BR2_PACKAGE_HOST_OPENOCD=y
```
